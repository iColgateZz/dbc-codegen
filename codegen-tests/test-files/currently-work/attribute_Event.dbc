VERSION ""

NS_ :

BS_:

BU_: TheNode

BO_ 1234 INV2EventMsg1: 8 Inv2
 SG_ TheSignal : 0|8@1- (1,0) [0|0] "" Vector__XXX

BA_DEF_ BO_  "GenMsgSendType" STRING ;
BA_DEF_ BO_  "GenMsgCycleTime" INT 0 100;
BA_ "GenMsgSendType" BO_ 1234 "Event";
BA_ "GenMsgCycleTime" BO_ 1234 0;
