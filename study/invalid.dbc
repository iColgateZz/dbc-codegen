NS_ :

BS_:

BU_: ECU1 ECU2

BO_ 100 DuplicateIdA: 8 ECU1
 SG_ OverlapA : 0|16@1+ (1,0) [0|65535] "" ECU2
 SG_ OverlapB : 8|16@1+ (1,0) [0|65535] "" ECU2
 SG_ LeavesUnusedGap : 40|8@1+ (1,0) [0|255] "" ECU2

BO_ 100 DuplicateIdB: 8 ECU1
 SG_ SomeSignal : 0|8@1+ (1,0) [0|255] "" ECU2

BO_ 200 ZeroZeroRangeMessage: 8 ECU1
 SG_ ZeroZeroNotAllowed : 0|8@1+ (1,0) [0|0] "" ECU2

BO_ 300 InvalidSignalLayoutMessage: 8 ECU1
 SG_ TooLongForMessage : 0|65@1+ (1,0) [0|0] "" ECU2

BO_ 400 NonRepresentablePhysicalRangeMessage: 8 ECU1
 SG_ UnsignedEightBitImpossibleRange : 0|8@1+ (1,0) [0|300] "" ECU2
 SG_ SignedFourBitImpossibleRange : 16|4@1- (1,0) [-20|20] "" ECU2

BO_ 500 UnsafeScalingArithmeticMessage: 8 ECU1
 SG_ TinyFactorHugeOffset : 0|64@1+ (0.00000000000000000000000000000000000001,100000000000000000000000000000000000000) [0|18446744073709551615] "" ECU2

BO_ 600 BadEnumVariantsMessage: 8 ECU1
 SG_ BadEnumSignal : 0|8@1+ (1,0) [0|255] "" ECU2

VAL_ 600 BadEnumSignal 0 "State" 1 "State" 2 "" 3 "BadEnumSignal" 4 "1st value" ;

BO_ 700 UnsupportedMultiplexingMultipleMuxors: 8 ECU1
 SG_ MuxA M : 0|4@1+ (1,0) [0|15] "" ECU2
 SG_ MuxB M : 4|4@1+ (1,0) [0|15] "" ECU2
 SG_ DataA m0 : 8|8@1+ (1,0) [0|255] "" ECU2

BO_ 800 UnsupportedMultiplexingMuxorAlsoMuxed: 8 ECU1
 SG_ MainMux M : 0|4@1+ (1,0) [0|15] "" ECU2
 SG_ NestedMux m0M : 4|4@1+ (1,0) [0|15] "" ECU2
 SG_ NestedData m1 : 8|8@1+ (1,0) [0|255] "" ECU2

BO_ 900 ExtendedMultiplexingMessage: 8 ECU1
 SG_ ExtMux M : 0|4@1+ (1,0) [0|15] "" ECU2
 SG_ ExtData m0 : 8|8@1+ (1,0) [0|255] "" ECU2

SG_MUL_VAL_ 900 ExtData ExtMux 1-3, 7-9;
